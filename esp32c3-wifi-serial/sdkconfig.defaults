## esp32c3-wifi-serial/sdkconfig.defaults
```kconfig
# ============================================================
#  默认配置 (idf.py set-target esp32c3 后自动生效)
# ============================================================
CONFIG_IDF_TARGET="esp32c3"

# ---------- Flash / 分区 ----------
CONFIG_ESPTOOLPY_FLASHSIZE_4MB=y
CONFIG_ESPTOOLPY_FLASHSIZE="4MB"
CONFIG_PARTITION_TABLE_CUSTOM=y
CONFIG_PARTITION_TABLE_CUSTOM_FILENAME="partitions.csv"

# ---------- 控制台 ----------
# 关键: 日志留在 UART0(GPIO21/20, 115200)，把 USB Serial/JTAG 整个让给"串口透传"。
# 如果你的 dongle 没有引出 UART0、完全拿不到日志, 请改成下面这行(取消注释):
#   CONFIG_ESP_CONSOLE_NONE=y
CONFIG_ESP_CONSOLE_UART_DEFAULT=y
CONFIG_ESP_CONSOLE_UART_BAUDRATE=115200
CONFIG_ESP_CONSOLE_UART_NUM=0

# ---------- HTTP 服务器 (WebSocket 终端必需) ----------
CONFIG_HTTPD_WS_SUPPORT=y
CONFIG_HTTPD_MAX_REQ_HDR_LEN=1024
CONFIG_HTTPD_MAX_URI_LEN=256

# ---------- LWIP ----------
# httpd(8) + TCP服务端/客户端 需要足够的 socket
CONFIG_LWIP_MAX_SOCKETS=12
CONFIG_LWIP_SO_RCVBUF=y
CONFIG_LWIP_SO_SNDTIMEO=y
CONFIG_LWIP_TCP_SND_BUF_DEFAULT=8192
CONFIG_LWIP_TCP_RCV_BUF_DEFAULT=8192
CONFIG_LWIP_TCP_MSL=6000
CONFIG_LWIP_DHCPS=y

# ---------- FreeRTOS / 系统 ----------
CONFIG_FREERTOS_HZ=1000
CONFIG_ESP_MAIN_TASK_STACK_SIZE=4096
CONFIG_ESP_SYSTEM_EVENT_TASK_STACK_SIZE=3072
CONFIG_ESP_TASK_WDT_TIMEOUT_S=10
CONFIG_LOG_DEFAULT_LEVEL_INFO=y
CONFIG_COMPILER_OPTIMIZATION_PERF=y

# ---------- Wi-Fi ----------
CONFIG_ESP_WIFI_STATIC_RX_BUFFER_NUM=8
CONFIG_ESP_WIFI_DYNAMIC_RX_BUFFER_NUM=32
CONFIG_ESP_WIFI_AMPDU_TX_ENABLED=y
CONFIG_ESP_WIFI_AMPDU_RX_ENABLED=y
CONFIG_ESP_WIFI_SOFTAP_SUPPORT=y

# ---------- mDNS ----------
CONFIG_MDNS_MAX_SERVICES=6
CONFIG_MDNS_TASK_STACK_SIZE=4096
```
